/*
 * LED3 OLED 驱动 verbatim 移植 (D:/tools1/LED3/MDK-ARM/OLED.c + OLED_Data.c 的 OLED_F8x16)
 * 用于对照测试: 同一块 GD32 板, LED3 固件显示正常, local_test 显示重复。
 * 本文件用 LED3 原版 OLED.c 的初始化/传输/渲染路径 + 原版字体, 排除驱动差异。
 */
#include "stm32f1xx_hal.h"
#include <string.h>
#include <stdio.h>
#include <stdbool.h>

extern I2C_HandleTypeDef hi2c1;

#define OLED_ADDRESS    0x78
#define OLED_I2C_TIMEOUT 100
#define OLED_PAGE       8
#define OLED_COLUMN     128

typedef enum { OLED_COLOR_NORMAL = 0, OLED_COLOR_REVERSED } OLED_ColorMode;

typedef struct ASCIIFont { uint8_t h; uint8_t w; uint8_t *chars; } ASCIIFont;

uint8_t OLED_GRAM[OLED_PAGE][OLED_COLUMN];

/* ---- LED3 原版 8x16 字体 (OLED_Data.c OLED_F8x16, 95 字符) ---- */
static const uint8_t OLED_F8x16[][16] = {
	0x00,0x00,0x00,0x00,0x00,0x00,0x00,0x00,0x00,0x00,0x00,0x00,0x00,0x00,0x00,0x00,
	0x00,0x00,0x00,0xF8,0x00,0x00,0x00,0x00,0x00,0x00,0x00,0x33,0x30,0x00,0x00,0x00,
	0x00,0x16,0x0E,0x00,0x16,0x0E,0x00,0x00,0x00,0x00,0x00,0x00,0x00,0x00,0x00,0x00,
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	0x00,0x00,0x08,0x04,0x08,0x10,0x08,0x00,0x00,0x00,0x00,0x00,0x00,0x00,0x00,0x00,
};

static const ASCIIFont afont16x8 = { .h = 16, .w = 8, .chars = (uint8_t *)OLED_F8x16 };

/* 前置声明 (OLED_Init 先于定义调用) */
void OLED_NewFrame(void);
void OLED_ShowFrame(void);

/* ---- LED3 底层通信 (OLED.c 原版) ---- */
void OLED_Send(uint8_t *data, uint8_t len) {
  HAL_I2C_Master_Transmit(&hi2c1, OLED_ADDRESS, data, len, OLED_I2C_TIMEOUT);
}
void OLED_SendCmd(uint8_t cmd) {
  uint8_t sendBuffer[2] = {0x00, cmd};
  OLED_Send(sendBuffer, 2);
}
bool OLED_CheckConnection(void) {
  uint8_t check_cmd[2] = {0x00, 0xAE};
  return (HAL_I2C_Master_Transmit(&hi2c1, OLED_ADDRESS, check_cmd, 2, 100) == HAL_OK);
}

/* ---- LED3 初始化 (OLED.c 原版, 含 100ms 延时, 不发空白帧) ---- */
uint8_t OLED_Init(void) {
  if (!OLED_CheckConnection()) return 1;
  HAL_Delay(100);
  OLED_SendCmd(0xAE);
  OLED_SendCmd(0xA8);
  OLED_SendCmd(0x3F);
  OLED_SendCmd(0xD3);
  OLED_SendCmd(0x00);
  OLED_SendCmd(0x40);
  OLED_SendCmd(0xA1);
  OLED_SendCmd(0xC8);
  OLED_SendCmd(0xDA);
  OLED_SendCmd(0x12);
  OLED_SendCmd(0x81);
  OLED_SendCmd(0x7F);
  OLED_SendCmd(0xA6);
  OLED_SendCmd(0x8D);
  OLED_SendCmd(0x14);
  OLED_NewFrame();
  OLED_ShowFrame();
  OLED_SendCmd(0xAF);
  return 0;
}

/* ---- 显存/渲染 (OLED.c 原版) ---- */
void OLED_NewFrame(void) { memset(OLED_GRAM, 0x00, sizeof(OLED_GRAM)); }

void OLED_ShowFrame(void) {
  for (uint8_t page = 0; page < OLED_PAGE; page++) {
    OLED_SendCmd(0xB0 + page);
    OLED_SendCmd(0x00);
    OLED_SendCmd(0x10);
    uint8_t sendBuffer[OLED_COLUMN + 1];
    sendBuffer[0] = 0x40;
    memcpy(&sendBuffer[1], OLED_GRAM[page], OLED_COLUMN);
    HAL_I2C_Master_Transmit(&hi2c1, OLED_ADDRESS, sendBuffer, OLED_COLUMN + 1, OLED_I2C_TIMEOUT);
  }
}

void OLED_SetPixel(uint8_t x, uint8_t y, OLED_ColorMode color) {
  if (x >= OLED_COLUMN || y >= 8 * OLED_PAGE) return;
  uint8_t page = y / 8;
  uint8_t bit = y % 8;
  if (color == OLED_COLOR_NORMAL) OLED_GRAM[page][x] |= (1 << bit);
  else OLED_GRAM[page][x] &= ~(1 << bit);
}

void OLED_SetBlock(uint8_t x, uint8_t y, const uint8_t *data, uint8_t w, uint8_t h, OLED_ColorMode color) {
  if (x + w > OLED_COLUMN || y + h > 8 * OLED_PAGE) return;
  if (data == NULL) return;
  for (uint8_t j = 0; j < w; j++) {
    for (uint8_t i = 0; i < h; i++) {
      uint8_t page = (y + i) / 8;
      uint8_t bit_pos = (y + i) % 8;
      if (x + j < OLED_COLUMN && page < OLED_PAGE) {
        uint8_t data_idx = j + (i / 8) * w;
        uint8_t byte_data = data[data_idx];
        if (color == OLED_COLOR_REVERSED) byte_data = ~byte_data;
        uint8_t pixel = (byte_data >> (i % 8)) & 0x01;
        if (pixel) OLED_GRAM[page][x + j] |= (1 << bit_pos);
        else OLED_GRAM[page][x + j] &= ~(1 << bit_pos);
      }
    }
  }
}

void OLED_PrintASCIIChar(uint8_t x, uint8_t y, char ch, const ASCIIFont *font, OLED_ColorMode color) {
  if (ch < ' ' || ch > '~') ch = ' ';
  if (font == NULL || font->chars == NULL) return;
  uint16_t char_offset = (ch - ' ') * ((font->h + 7) / 8) * font->w;
  OLED_SetBlock(x, y, font->chars + char_offset, font->w, font->h, color);
}

void OLED_PrintASCIIString(uint8_t x, uint8_t y, char *str, const ASCIIFont *font, OLED_ColorMode color) {
  uint8_t x0 = x;
  while (*str) {
    OLED_PrintASCIIChar(x0, y, *str, font, color);
    x0 += font->w;
    str++;
  }
}

/* ---- 对照测试入口: 单行 TEST-A + 主循环 (复刻 ssd1306 版 uptime/心跳缓冲写入, 不 Upload) ---- */
void oled_led3_test(void)
{
  uint8_t r = OLED_Init();
  OLED_NewFrame();
  OLED_PrintASCIIString(0, 0, "TEST-A", &afont16x8, OLED_COLOR_NORMAL);
  OLED_ShowFrame();
  (void)r;
  uint32_t boot_tick = HAL_GetTick();
  uint32_t last_ui = 0, last_up = 0;
  uint8_t blink = 0;
  char line[16];
  while (1)
  {
    uint32_t now = HAL_GetTick();
    if (now - last_ui >= 500)
    {
      last_ui = now;
      blink = (uint8_t)(1 - blink);
      if (now - last_up >= 1000)
      {
        last_up = now;
        /* 清 uptime 区 (页 7 x=72..119) 再画 "00000s" */
        for (uint8_t xx = 72; xx < 120; xx++)
          for (uint8_t yy = 56; yy < 64; yy++)
            OLED_SetPixel(xx, yy, OLED_COLOR_REVERSED);
        snprintf(line, sizeof(line), "%05lus", (now - boot_tick) / 1000);
        OLED_PrintASCIIString(72, 56, line, &afont16x8, OLED_COLOR_NORMAL);
      }
      /* 心跳方块 (页 7 x=120..127) */
      for (uint8_t xx = 120; xx < 128; xx++)
        for (uint8_t yy = 56; yy < 64; yy++)
          OLED_SetPixel(xx, yy, blink ? OLED_COLOR_NORMAL : OLED_COLOR_REVERSED);
      /* 与 ssd1306 版一致: 主循环不调用 OLED_ShowFrame (Update 禁用) */
    }
    HAL_Delay(50);
  }
}
